## CMakeLists.txt
```
# SPDX-License-Identifier: Apache-2.0
#
# Host (native_sim) ztest for MCUboot multi-key public key handling, against
# upstream MCUboot 2.5.0. Key files are resolved and embedded the same way as
# boot/zephyr/CMakeLists.txt, and the real boot/zephyr/keys.c builds the table.

cmake_minimum_required(VERSION 3.20.0)

get_filename_component(MCUBOOT_DIR "${CMAKE_CURRENT_SOURCE_DIR}/../../../bootloader/mcuboot" ABSOLUTE)
set(BOOT_DIR ${MCUBOOT_DIR}/boot)

find_package(Zephyr REQUIRED HINTS $ENV{ZEPHYR_BASE})
project(mcuboot_multikey_test)

# Split the comma-separated key list and resolve each entry (as upstream does).
string(REPLACE "," ";" key_list "${CONFIG_BOOT_SIGNATURE_KEY_FILE}")
list(LENGTH key_list key_count)
set(key_index 0)
foreach(raw_key_path IN LISTS key_list)
  string(CONFIGURE "${raw_key_path}" key_path)
  if(IS_ABSOLUTE ${key_path})
    set(resolved_key_path ${key_path})
  elseif(EXISTS ${APPLICATION_CONFIG_DIR}/${key_path})
    set(resolved_key_path ${APPLICATION_CONFIG_DIR}/${key_path})
  else()
    set(resolved_key_path ${MCUBOOT_DIR}/${key_path})
  endif()

  # Entry 0 keeps the plain symbol names; later entries get an index suffix,
  # matching what keys.c expects.
  if(key_index EQUAL 0)
    set(generated_pubkey ${ZEPHYR_BINARY_DIR}/autogen-pubkey.c)
    set(name_suffix_arg "")
  else()
    set(generated_pubkey ${ZEPHYR_BINARY_DIR}/autogen-pubkey-${key_index}.c)
    set(name_suffix_arg --name-suffix _${key_index})
  endif()
  message(STATUS "MCUboot verification key #${key_index}: ${resolved_key_path}")

  add_custom_command(
    OUTPUT ${generated_pubkey}
    COMMAND ${PYTHON_EXECUTABLE} ${MCUBOOT_DIR}/scripts/imgtool.py
            getpub -k ${resolved_key_path} ${name_suffix_arg} -o ${generated_pubkey}
    DEPENDS ${resolved_key_path}
  )
  target_sources(app PRIVATE ${generated_pubkey})
  math(EXPR key_index "${key_index} + 1")
endforeach()

message(STATUS "multi-key test embeds ${key_count} keys")
target_compile_definitions(app PRIVATE MCUBOOT_SIGN_KEY_COUNT=${key_count})

# bootutil sources needed for key lookup and RSA-PSS verification.
zephyr_include_directories(
  ${BOOT_DIR}/bootutil/include
  ${BOOT_DIR}/bootutil/src
  ${BOOT_DIR}/zephyr/include
)
zephyr_sources(
  ${BOOT_DIR}/bootutil/src/bootutil_find_key.c
  ${BOOT_DIR}/bootutil/src/image_ecdsa.c
  ${BOOT_DIR}/bootutil/src/fault_injection_hardening.c
  ${BOOT_DIR}/bootutil/src/bootutil_misc.c
)

target_sources(app PRIVATE
  ${BOOT_DIR}/zephyr/keys.c
  src/main.c
)
```

## Kconfig
```
# Kconfig for the MCUboot multi-key ztest. Pulls in MCUboot's own options so the
# bootutil sources see the same CONFIG_BOOT_* symbols as the bootloader build.
mainmenu "MCUboot multi-key ztest"

rsource "../../../bootloader/mcuboot/boot/zephyr/Kconfig"
```

## prj.conf
```kconfig
# Test-only configuration: bootutil ECDSA P-256 verification (PSA Crypto backend, MbedTLS 4.x).
CONFIG_ZTEST=y
CONFIG_ASSERT=y
# Third-party TF-PSA-Crypto trips -Werror (unused parameters) on this toolchain.
CONFIG_COMPILER_WARNINGS_AS_ERRORS=n
CONFIG_LOG=y
# MCUboot selects the flash map; give it a flash driver on native_sim.
CONFIG_FLASH=y
CONFIG_FLASH_SIMULATOR=y

CONFIG_BOOT_SIGNATURE_TYPE_ECDSA_P256=y
CONFIG_BOOT_ECDSA_PSA=y
CONFIG_MBEDTLS=y
CONFIG_MBEDTLS_BUILTIN=y
CONFIG_BOOT_IMG_HASH_ALG_SHA256=y

# Upstream MCUboot 2.5.0 key list: root keypair first, then public-only PEMs.
# All entries must share one signature type (P-256 here).
# Paths are relative to this test directory (APPLICATION_CONFIG_DIR).
CONFIG_BOOT_SIGNATURE_KEY_FILE="../../../bootloader/mcuboot/root-ec-p256.pem,../../app/dmc/sysbuild/test-keys/p256/test-key-a-p256.pub.pem,../../app/dmc/sysbuild/test-keys/p256/test-key-b-p256.pub.pem"
```

## mcuboot-multikey.conf
```kconfig
# TEST ONLY: MCUboot with extra embedded public keys (see bootloader/mcuboot
# boot/zephyr/Kconfig BOOT_EXTRA_SIGNATURE_KEY_FILES). Paths resolve relative to
# mcuboot's boot/zephyr directory.
CONFIG_BOOT_EXTRA_SIGNATURE_KEY_FILES="\${APPLICATION_CONFIG_DIR}/../../../../tt-system-firmware/app/dmc/sysbuild/test-keys/test-key-a.pem;\${APPLICATION_CONFIG_DIR}/../../../../tt-system-firmware/app/dmc/sysbuild/test-keys/test-key-b.pem"
```

## src/main.c
```c
/*
 * SPDX-License-Identifier: Apache-2.0
 *
 * ztest for MCUboot multi-key support (test builds only).
 *
 * Exercises the real bootutil key lookup (bootutil_find_key) and ECDSA P-256
 * signature verification (bootutil_verify_sig) against the generated
 * bootutil_keys[] table, which holds the root key plus the two test keys.
 *
 * Also checks an image produced by the external-signer flow in
 * gen_roundtrip.sh (imgtool --vector-to-sign digest, openssl signing the
 * digest, imgtool --fix-sig/--fix-sig-pubkey), by doing what MCUboot does at
 * boot: hash the protected region, match the SHA-256 TLV, select the key by
 * KEYHASH, and verify the signature TLV.
 */

#include <zephyr/ztest.h>
#include <zephyr/logging/log.h>

#include <bootutil/sign_key.h>
#include <bootutil/crypto/sha.h>
#include <bootutil/fault_injection_hardening.h>

#include "vectors.h"
#include "roundtrip_image.h"

LOG_MODULE_REGISTER(mcuboot, LOG_LEVEL_WRN);

/* Key IDs follow the table order: primary (root) first, then the extras. */
#define KEY_ID_ROOT  0
#define KEY_ID_TEST_A 1
#define KEY_ID_TEST_B 2

#define HASH_LEN 32

/* From bootutil/src/bootutil_find_key.c (not declared in a public header). */
int bootutil_find_key(uint8_t *keyhash, uint8_t keyhash_len);

/* From bootutil/src/image_rsa.c. */
fih_ret bootutil_verify_sig(uint8_t *hash, uint32_t hlen, uint8_t *sig,
			    size_t slen, uint8_t key_id);

static void sha256_of_key(int idx, uint8_t out[HASH_LEN])
{
	bootutil_sha_context ctx;

	bootutil_sha_init(&ctx);
	bootutil_sha_update(&ctx, bootutil_keys[idx].key, *bootutil_keys[idx].len);
	bootutil_sha_finish(&ctx, out);
	bootutil_sha_drop(&ctx);
}

static bool verify_ok(const uint8_t *sig, size_t sig_len, uint8_t key_id)
{
	/* bootutil_verify_sig takes a non-const hash/sig pointer. */
	uint8_t digest[HASH_LEN];
	uint8_t sig_copy[256];
	fih_ret rc;

	memcpy(digest, vec_digest, sizeof(digest));
	memcpy(sig_copy, sig, sig_len);

	rc = bootutil_verify_sig(digest, sizeof(digest), sig_copy, sig_len, key_id);
	return rc == FIH_SUCCESS;
}

/* MCUboot image format constants (boot/bootutil/include/bootutil/image.h). */
#define IMG_HDR_MAGIC   0x96f3b83dU
#define TLV_INFO_MAGIC  0x6907U
#define TLV_KEYHASH     0x01U
#define TLV_SHA256      0x10U
#define TLV_ECDSA_SIG   0x22U
#define IMG_PAYLOAD_OFF 0x200U

static uint32_t rd32(const uint8_t *p)
{
	return (uint32_t)p[0] | ((uint32_t)p[1] << 8) | ((uint32_t)p[2] << 16) |
	       ((uint32_t)p[3] << 24);
}

static uint16_t rd16(const uint8_t *p)
{
	return (uint16_t)(p[0] | (p[1] << 8));
}

/*
 * Find the TLV area as MCUboot does: header size, image size and protected
 * TLV size give the offset of the TLV info block. The bytes before it are the
 * protected region that the image hash covers.
 */
static bool rt_locate(const uint8_t *img, size_t len, uint32_t *tlv_off,
		      uint16_t *tlv_total)
{
	uint32_t hdr, prot, img_sz, off;
	uint16_t total;

	if (len < 16 || rd32(img) != IMG_HDR_MAGIC) {
		return false;
	}
	hdr = rd16(img + 8);
	prot = rd16(img + 10);
	img_sz = rd32(img + 12);
	off = hdr + img_sz + prot;
	if (off + 4 > len || rd16(img + off) != TLV_INFO_MAGIC) {
		return false;
	}
	total = rd16(img + off + 2);
	if (off + total > len) {
		return false;
	}
	*tlv_off = off;
	*tlv_total = total;
	return true;
}

static bool rt_find(const uint8_t *img, uint32_t tlv_off, uint16_t tlv_total,
		    uint16_t type, const uint8_t **val, uint16_t *vlen)
{
	uint16_t pos = 4;

	while ((uint32_t)pos + 4 <= tlv_total) {
		uint16_t t = rd16(img + tlv_off + pos);
		uint16_t l = rd16(img + tlv_off + pos + 2);

		if ((uint32_t)pos + 4 + l > tlv_total) {
			return false;
		}
		if (t == type) {
			*val = img + tlv_off + pos + 4;
			*vlen = l;
			return true;
		}
		pos += 4 + l;
	}
	return false;
}

/* Returns the key index that accepts the image, or -1. */
static int rt_verify(uint8_t *img, size_t len)
{
	uint32_t tlv_off;
	uint16_t tlv_total, hash_l, kh_l, sig_l;
	const uint8_t *hash_v, *kh_v, *sig_v;
	uint8_t digest[HASH_LEN];
	bootutil_sha_context ctx;
	fih_ret rc;
	int key_id;

	if (!rt_locate(img, len, &tlv_off, &tlv_total)) {
		return -1;
	}

	/* 1. Hash the protected region: header, payload, protected TLVs. */
	bootutil_sha_init(&ctx);
	bootutil_sha_update(&ctx, img, tlv_off);
	bootutil_sha_finish(&ctx, digest);
	bootutil_sha_drop(&ctx);

	/* 2. The SHA-256 TLV must match the computed digest. */
	if (!rt_find(img, tlv_off, tlv_total, TLV_SHA256, &hash_v, &hash_l) ||
	    hash_l != HASH_LEN || memcmp(hash_v, digest, HASH_LEN) != 0) {
		return -1;
	}

	/* 3. The key-hash TLV selects an embedded key. */
	if (!rt_find(img, tlv_off, tlv_total, TLV_KEYHASH, &kh_v, &kh_l) ||
	    kh_l != HASH_LEN) {
		return -1;
	}
	key_id = bootutil_find_key((uint8_t *)kh_v, kh_l);
	if (key_id < 0) {
		return -1;
	}

	/* 4. The signature TLV must verify the digest under that key. */
	if (!rt_find(img, tlv_off, tlv_total, TLV_ECDSA_SIG, &sig_v, &sig_l)) {
		return -1;
	}
	rc = bootutil_verify_sig(digest, HASH_LEN, (uint8_t *)sig_v, sig_l,
				 (uint8_t)key_id);
	return rc == FIH_SUCCESS ? key_id : -1;
}

ZTEST_SUITE(mcuboot_multikey, NULL, NULL, NULL, NULL, NULL);

ZTEST(mcuboot_multikey, test_key_count_is_three)
{
	zassert_equal(bootutil_key_cnt, 3, "expected root + 2 test keys, got %d",
		      bootutil_key_cnt);
}

ZTEST(mcuboot_multikey, test_each_embedded_key_is_found_by_hash)
{
	for (int i = 0; i < bootutil_key_cnt; i++) {
		uint8_t hash[HASH_LEN];

		sha256_of_key(i, hash);
		zassert_equal(bootutil_find_key(hash, sizeof(hash)), i,
			      "key %d not found by its own hash", i);
	}
}

ZTEST(mcuboot_multikey, test_unknown_key_hash_is_rejected)
{
	uint8_t hash[HASH_LEN];

	memset(hash, 0xA5, sizeof(hash));
	zassert_equal(bootutil_find_key(hash, sizeof(hash)), -1,
		      "unknown key hash was matched");
}

ZTEST(mcuboot_multikey, test_signature_by_test_key_a_accepted_under_key_a)
{
	zassert_true(verify_ok(vec_sig_a, sizeof(vec_sig_a), KEY_ID_TEST_A),
		     "test-key-a signature rejected under test-key-a");
}

ZTEST(mcuboot_multikey, test_signature_by_test_key_b_accepted_under_key_b)
{
	zassert_true(verify_ok(vec_sig_b, sizeof(vec_sig_b), KEY_ID_TEST_B),
		     "test-key-b signature rejected under test-key-b");
}

ZTEST(mcuboot_multikey, test_signature_by_test_key_b_rejected_under_root)
{
	zassert_false(verify_ok(vec_sig_b, sizeof(vec_sig_b), KEY_ID_ROOT),
		      "test-key-b signature accepted under root key");
}

ZTEST(mcuboot_multikey, test_signature_by_test_key_b_rejected_under_key_a)
{
	zassert_false(verify_ok(vec_sig_b, sizeof(vec_sig_b), KEY_ID_TEST_A),
		      "test-key-b signature accepted under test-key-a");
}

ZTEST(mcuboot_multikey, test_signature_by_test_key_a_rejected_under_key_b)
{
	zassert_false(verify_ok(vec_sig_a, sizeof(vec_sig_a), KEY_ID_TEST_B),
		      "test-key-a signature accepted under test-key-b");
}

ZTEST(mcuboot_multikey, test_roundtrip_image_verifies_under_key_b)
{
	uint8_t img[sizeof(roundtrip_image)];

	memcpy(img, roundtrip_image, sizeof(img));
	zassert_equal(rt_verify(img, sizeof(img)), KEY_ID_TEST_B,
		      "external-signer image not accepted under test-key-b");
}

ZTEST(mcuboot_multikey, test_roundtrip_tampered_payload_is_rejected)
{
	uint8_t img[sizeof(roundtrip_image)];

	memcpy(img, roundtrip_image, sizeof(img));
	img[IMG_PAYLOAD_OFF + 100] ^= 0x01;
	zassert_equal(rt_verify(img, sizeof(img)), -1,
		      "image with a modified payload was accepted");
}

ZTEST(mcuboot_multikey, test_roundtrip_tampered_signature_is_rejected)
{
	uint8_t img[sizeof(roundtrip_image)];
	uint32_t tlv_off;
	uint16_t tlv_total, sig_l;
	const uint8_t *sig_v;

	memcpy(img, roundtrip_image, sizeof(img));
	zassert_true(rt_locate(img, sizeof(img), &tlv_off, &tlv_total),
		     "round-trip image has no TLV area");
	zassert_true(rt_find(img, tlv_off, tlv_total, TLV_ECDSA_SIG, &sig_v, &sig_l),
		     "round-trip image has no signature TLV");
	img[sig_v - img + sig_l / 2] ^= 0x01;
	zassert_equal(rt_verify(img, sizeof(img)), -1,
		      "image with a modified signature was accepted");
}
```

## src/vectors.h
```c
/* Generated by gen_vectors.sh. TEST ONLY. */
#include <stdint.h>
static const uint8_t vec_digest[32] = {0xd0,0x92,0xa5,0xee,0x69,0xd8,0x84,0x3c,0xf1,0x69,0xef,0x45,0x02,0x65,0x32,0x28,0x72,0xe3,0x55,0x45,0xe8,0xa9,0x6f,0x2b,0x35,0xb3,0x18,0x41,0xfe,0x5a,0x6b,0x5b,};
static const uint8_t vec_sig_a[] = {0x30,0x46,0x02,0x21,0x00,0xb6,0x94,0xe0,0xdd,0xed,0x5f,0x2a,0x4e,0xc3,0x24,0x25,0x28,0xe0,0x96,0x9a,0xce,0x6a,0xb0,0x1a,0xfb,0x20,0x02,0xb0,0x8e,0x6e,0xfa,0x65,0x9e,0xff,0x5e,0xfd,0xe9,0x02,0x21,0x00,0xd0,0xd9,0x77,0x07,0x0c,0x83,0xb2,0x5e,0x51,0xc8,0x93,0xa5,0x3d,0x07,0x8d,0xef,0x56,0x24,0x65,0xf4,0x79,0x02,0x6d,0xcc,0x4b,0xd2,0x89,0xcd,0xfa,0xf2,0x20,0x28,};
static const uint8_t vec_sig_b[] = {0x30,0x45,0x02,0x20,0x59,0x75,0xd7,0xf6,0xac,0xc2,0xc9,0x5b,0x2b,0xbf,0x93,0xac,0xbb,0x85,0x54,0xd8,0x60,0x7b,0x65,0xed,0xab,0x24,0x97,0x5a,0xe5,0x56,0x10,0x55,0x7b,0x0f,0x7d,0xbe,0x02,0x21,0x00,0xc9,0x7e,0x6a,0xff,0xd0,0xc2,0xdc,0x0f,0xce,0x2c,0x8c,0x9b,0xa7,0x3b,0xa7,0x76,0x7b,0x68,0x2a,0x7f,0xfd,0xdf,0xef,0x84,0x2b,0xfa,0x1a,0x7e,0x86,0x94,0x2a,0xe7,};
```
