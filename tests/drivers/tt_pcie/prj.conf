## CMakeLists.txt
```
# Copyright (c) 2026 Tenstorrent AI ULC
# SPDX-License-Identifier: Apache-2.0

cmake_minimum_required(VERSION 3.20.0)
find_package(Zephyr REQUIRED HINTS $ENV{ZEPHYR_BASE})
project(tt_pcie)

target_sources(app PRIVATE src/main.c src/stage_bundle.c)

# Embed the real SERDES ICCM/DCCM images from the SiVal SDK
set(SIVAL_EXTDIR ${CMAKE_BINARY_DIR}/grendel-sival-sdk)
set(SIVAL_BLOBS_TARBALL ${CMAKE_CURRENT_SOURCE_DIR}/../../../zephyr/blobs/grendel-sival-sdk.tar.gz)
set(SERDES_FW_DIR ${SIVAL_EXTDIR}/grendel_sival_sdk/firmware/drivers/pcie/fw)

file(MAKE_DIRECTORY ${SIVAL_EXTDIR})
execute_process(COMMAND tar -xzf ${SIVAL_BLOBS_TARBALL} WORKING_DIRECTORY ${SIVAL_EXTDIR}
  RESULT_VARIABLE SIVAL_TAR_RESULT)
if(NOT SIVAL_TAR_RESULT EQUAL 0)
  message(FATAL_ERROR "Failed to extract ${SIVAL_BLOBS_TARBALL}")
endif()

set(GEN_DIR ${ZEPHYR_BINARY_DIR}/include/generated)
foreach(mem iccm dccm)
  set(fw ${SERDES_FW_DIR}/serdes_${mem}_fw.bin)
  file(SIZE ${fw} fw_size)
  if(fw_size GREATER 65536)
    message(FATAL_ERROR "${fw} is ${fw_size} bytes; the driver reserves 64 KiB for ${mem}")
  endif()
  generate_inc_file_for_target(app ${fw} ${GEN_DIR}/serdes_${mem}_fw.bin.inc)
endforeach()
```

## prj.conf
```kconfig
# Copyright (c) 2026 Tenstorrent AI ULC
# SPDX-License-Identifier: Apache-2.0

CONFIG_TT_GRENDEL_PCIE=y
CONFIG_TT_GRENDEL_PCIE_HW_INIT=y
CONFIG_TT_GRENDEL_HSIO=y
CONFIG_LOG=y
CONFIG_ZTEST=y
CONFIG_TT_GR_SMC=y
# Makes a passing suite write 0xACAFACA1 to scratch[0] as well as reporting on
# the console. Emulation has no console reader, so without this a run that
# passes is indistinguishable from one that never finished.
CONFIG_ZTEST_TC_UTIL_USER_OVERRIDE=y
# VDK simulation does not support programming the PMP with stack protection
CONFIG_TEST_HW_STACK_PROTECTION=n
# Shell timeouts assume 1 MHz mtime; emul ticks at ~100 kHz.
CONFIG_SHELL=n
```

## src/main.c
```c
/*
 * Copyright (c) 2026 Tenstorrent AI ULC
 *
 * SPDX-License-Identifier: Apache-2.0
 */

#include <zephyr/device.h>
#include <zephyr/devicetree.h>
#include <zephyr/ztest.h>

#include <soc.h>

#define PCIE0_NODE DT_NODELABEL(pcie0)

static const struct device *const pcie0 = DEVICE_DT_GET(PCIE0_NODE);

/*
 * The only thing visible from the host while the tests run are the scratch
 * registers which the harness prints on every poll. Each step publishes which
 * test it is in and how far it got, so a run that stops responding names the
 * call it stopped in instead of just failing to reach the pass token.
 * scratch[4] carries the value the step just produced.
 *
 * The tag makes step 0 distinguishable from a scratch register nobody has
 * written yet.
 */
#define STEP(test, step) WRITE_SCRATCH(3, 0xB0000000U | ((test) << 8) | (step))
#define STEP_RESULT(val) WRITE_SCRATCH(4, (uint32_t)(val))

#define T_READY 0x00U

/*
 * A failing assertion ends its test but not the suite, and the suite's pass
 * token is only written if every test passed -- so without this a run with one
 * broken test is indistinguishable from a run with six. Each test sets its bit
 * on the way out; whatever is missing at the end failed.
 */
static uint32_t passed_mask;

#define PASSED(bit)                                                                                \
	do {                                                                                       \
		passed_mask |= BIT(bit);                                                           \
		WRITE_SCRATCH(1, 0xA5000000U | passed_mask);                                       \
	} while (0)

#define P_READY 0

ZTEST(tt_pcie, test_endpoint_ready)
{
	STEP(T_READY, 1);
	STEP_RESULT(device_is_ready(pcie0));
	zassert_true(device_is_ready(pcie0), "pcie0 not ready");
	STEP(T_READY, 2);
	PASSED(P_READY);
}

ZTEST_SUITE(tt_pcie, NULL, NULL, NULL, NULL, NULL);
```

## src/stage_bundle.c
```c
/*
 * Copyright (c) 2026 Tenstorrent AI ULC
 *
 * SPDX-License-Identifier: Apache-2.0
 */

/*
 * tt_grendel_pcie (HW_INIT) expects BL1 to have staged a firmware bundle at
 * TT_BUN1_STAGING_AREA_ADDR with the SERDES FW at TOC[2]. This test runs
 * standalone, so stage a minimal bundle before the PCIe device initialises.
 *
 * Layout: only the manifest and TOC are written into the staging area, which
 * lies below ram0 and so can never collide with this image. The SERDES blob is
 * an ordinary array inside the image; its TOC offset is simply the distance
 * from the end of the manifest to the array, so no payload is copied into the
 * staging area and nothing there overlaps the image.
 *
 * The blob holds the real SERDES ICCM and DCCM images from the SiVal SDK
 * (embedded by CMakeLists.txt), so the test also brings the link up on silicon.
 */

#include <string.h>

#include <zephyr/devicetree.h>
#include <zephyr/drivers/misc/tt_bundle_loader.h>
#include <zephyr/init.h>
#include <zephyr/sys/util.h>

#define TOC_ENTRY_COUNT 3U
#define SERDES_TOC_IDX  2U

/* The driver points DCCM 16384 words past ICCM; give each a full 16384 words. */
#define SERDES_MEM_BYTES (16384U * sizeof(uint32_t))

#define STAGING_BASE  TT_BUN1_STAGING_AREA_ADDR
#define STAGING_LIMIT DT_REG_ADDR(DT_NODELABEL(ram0))

#define TOC_OFFSET   ROUND_UP(sizeof(struct fw_bundle_manifest), 8)
#define STAGING_USED (TOC_OFFSET + sizeof(struct fw_bundle_toc) +                                  \
		      TOC_ENTRY_COUNT * sizeof(struct fw_bundle_toc_entry))

BUILD_ASSERT(STAGING_BASE + STAGING_USED <= STAGING_LIMIT,
	     "staged manifest+TOC overruns the area below ram0");

/* CMakeLists.txt rejects images larger than SERDES_MEM_BYTES; shorter ones are zero-padded. */
static const struct {
	uint8_t iccm[SERDES_MEM_BYTES];
	uint8_t dccm[SERDES_MEM_BYTES];
} serdes_blob __aligned(4) = {
	.iccm = {
#include "serdes_iccm_fw.bin.inc"
	},
	.dccm = {
#include "serdes_dccm_fw.bin.inc"
	},
};

static int stage_bundle(void)
{
	struct fw_bundle_manifest *manifest = (struct fw_bundle_manifest *)STAGING_BASE;
	struct fw_bundle_toc *toc = (struct fw_bundle_toc *)(STAGING_BASE + TOC_OFFSET);
	uintptr_t blob = (uintptr_t)&serdes_blob;

	/* The blob must be outside the staged bytes; it is also required to be above them. */
	if (blob < STAGING_BASE + STAGING_USED) {
		return -EFAULT;
	}

	memset(manifest, 0, STAGING_USED);
	manifest->manifest_identifier = MANIFEST_ID_BL1;
	manifest->manifest_length = sizeof(*manifest);
	manifest->payload_offset = TOC_OFFSET;

	toc->toc_identifier = FW_BUNDLE_TOC_ID;
	toc->toc_version_major = 1;
	toc->image_count = TOC_ENTRY_COUNT;

	/* Offset is relative to staging base + payload_offset, as the driver computes it. */
	toc->entries[SERDES_TOC_IDX].offset = blob - STAGING_BASE - TOC_OFFSET;
	toc->entries[SERDES_TOC_IDX].length = sizeof(serdes_blob);

	return 0;
}

/* Must run before the PCIe device init (POST_KERNEL). */
SYS_INIT(stage_bundle, PRE_KERNEL_1, 0);
```
