## app/bl1/boards/tt_mmk_tt_mimir_smc.conf
```kconfig
# Copyright (c) 2026 Tenstorrent AI ULC
# SPDX-License-Identifier: Apache-2.0
CONFIG_I3C=y
CONFIG_I3C_TARGET_ROLE_ONLY=y
CONFIG_I3C_USE_IBI=n
```

## app/dmc/Kconfig
```kconfig
# Copyright (c) 2025 Tenstorrent AI ULC
# SPDX-License-Identifier: Apache-2.0

config DMC_RUN_SMBUS_TESTS
	bool "SMBUS test shell command"
	help
	  Add the "smc smbus_test" shell command, which runs DMC<->SMC SMBus
	  tests on demand. This can be used to verify functionality of the
	  SMBUS interface.

source "Kconfig.zephyr"
```

## boards/tenstorrent/tt_qsr1a1/Kconfig.tt_qsr1a1
```kconfig
# Copyright (c) 2026 Tenstorrent AI ULC
# SPDX-License-Identifier: Apache-2.0

config BOARD_TT_QSR1A1
	select SOC_TT_QUASAR_SMC if BOARD_TT_QSR1A1_TT_QUASAR_SMC
	select SOC_TT_KERAUNOS_SMC if BOARD_TT_QSR1A1_TT_KERAUNOS_SMC
	select SOC_TT_MIMIR_SMC if BOARD_TT_QSR1A1_TT_MIMIR_SMC
	select SIVAL_SDK if BOARD_TT_QSR1A1_TT_MIMIR_SMC
```

## boards/tenstorrent/tt_qsr1a1/board.yml
```yaml
board:
  name: tt_qsr1a1
  full_name: Tenstorrent Quasar 1 A1 Board
  vendor: tenstorrent
  socs:
    - name: tt_quasar
    - name: tt_keraunos
    - name: tt_mimir
```

## drivers/misc/tt_chiplet_remote_boot/Kconfig
```kconfig
# Copyright (c) 2026 Tenstorrent AI ULC
# SPDX-License-Identifier: Apache-2.0

config TT_CHIPLET_REMOTE_BOOT
	bool "Tenstorrent Chiplet Remote Boot Driver"
	default y
	depends on DT_HAS_TENSTORRENT_CHIPLET_REMOTE_BOOT_ENABLED
	depends on TT_SMC_REMOTEPROC
	select TT_D2D
	help
	  Enable the chiplet remote boot driver. Reads the chiplet FW image from
	  the BUN2 staging area at the configured TOC index, then OCCP-loads it via
	  the SMC remoteproc driver

if TT_CHIPLET_REMOTE_BOOT

config TT_CHIPLET_REMOTE_BOOT_INIT_PRIO
	int
	default 77
	help
	  Initialization priority of the Mimir remote boot driver. Must be
	  higher than TT_SMC_REMOTEPROC_INIT_PRIO (75).

module = TT_CHIPLET_REMOTE_BOOT
module-str = tt_chiplet_remote_boot
source "subsys/logging/Kconfig.template.log_config"

endif # TT_CHIPLET_REMOTE_BOOT
```

## drivers/misc/tt_mimir_remote_boot/Kconfig
```kconfig
# Copyright (c) 2026 Tenstorrent AI ULC
# SPDX-License-Identifier: Apache-2.0

config TT_MIMIR_REMOTE_BOOT
	bool "Tenstorrent Mimir Remote Boot Driver"
	default y
	depends on DT_HAS_TENSTORRENT_MIMIR_REMOTE_BOOT_ENABLED
	depends on TT_SMC_REMOTEPROC
	select TT_D2D
	help
	  Enable the Mimir remote boot driver. Reads the Mimir FW image from
	  the BUN2 staging area at the configured TOC index, then OCCP-loads it via
	  the SMC remoteproc driver

if TT_MIMIR_REMOTE_BOOT

config TT_MIMIR_REMOTE_BOOT_INIT_PRIO
	int
	default 77
	help
	  Initialization priority of the Mimir remote boot driver. Must be
	  higher than TT_SMC_REMOTEPROC_INIT_PRIO (75).

module = TT_MIMIR_REMOTE_BOOT
module-str = tt_mimir_remote_boot
source "subsys/logging/Kconfig.template.log_config"

endif # TT_MIMIR_REMOTE_BOOT
```

## dts/bindings/misc/tenstorrent,chiplet-remote-boot.yaml
```yaml
# Copyright (c) 2026 Tenstorrent AI ULC
# SPDX-License-Identifier: Apache-2.0

description: |
  Tenstorrent chiplet remote boot driver.

  Runs on the host die and boots each remote chiplet described by a child
  node. Each child names the chiplet type, the remoteproc it is loaded through,
  the BUN2 TOC entry holding its BL1 image, and the BUN3 TOC entry holding its
  MIS image. D2D FW and GDDR params images are shared by all remotes, so their
  TOC indices live on this node.

compatible: "tenstorrent,chiplet-remote-boot"

include: base.yaml

properties:
  d2d-fw-toc-index:
    type: int
    default: 2
    description: |
      Index into the BUN2 TOC for the D2D FW image, shared by all remotes.
      Defaults to 2.

  gddr-params-toc-index:
    type: int
    default: 3
    description: |
      Index into the BUN2 TOC for the GDDR params image, shared by all remotes.
      Defaults to 3.

  m-bl1-toc-idx:
    type: int
    required: false
    description: |
      Default BUN2 TOC index of the BL1 image for every child with
      chiplet-type "mimir". A child's own bl1-toc-index overrides it.

  m-mis-toc-idx:
    type: int
    required: false
    description: |
      Default BUN3 TOC index of the MIS image for every child with
      chiplet-type "mimir". A child's own mis-toc-index overrides it.

  q-bl1-toc-idx:
    type: int
    required: false
    description: |
      Default BUN2 TOC index of the BL1 image for every child with
      chiplet-type "quasar". A child's own bl1-toc-index overrides it.

  q-mis-toc-idx:
    type: int
    required: false
    description: |
      Default BUN3 TOC index of the MIS image for every child with
      chiplet-type "quasar". A child's own mis-toc-index overrides it.

child-binding:
  description: |
    One remote chiplet.

  properties:
    chiplet-type:
      type: string
      required: true
      enum:
        - "mimir"
        - "quasar"
      description: |
        Family of this remote chiplet. Selects nothing in the boot sequence
        yet; it is recorded for logging and for per-family behaviour.

    smc-remoteproc:
      type: phandle
      required: true
      description: |
        tenstorrent,smc-remoteproc device used to OCCP-load and start this
        chiplet.

    mis-mbox:
      type: phandle
      required: true
      description: |
        Mailbox used to prompt this chiplet to jump to its MIS image.

    mis-spa-base:
      type: array
      required: true
      description: |
        SPA base of this chiplet's core-local address window, as a {hi, lo}
        32-bit cell pair. The MIS image load address in the bundle is
        core-local and is added to this base to reach the chiplet.

    bl1-toc-index:
      type: int
      required: false
      description: |
        Index into the BUN2 TOC for this chiplet's BL1 image. Overrides the
        parent's default for its chiplet-type (m-bl1-toc-idx or q-bl1-toc-idx).
        Required unless that default is set.

    mis-toc-index:
      type: int
      required: false
      description: |
        Index into the BUN3 TOC for this chiplet's MIS image. Overrides the
        parent's default for its chiplet-type (m-mis-toc-idx or q-mis-toc-idx).
        Required unless that default is set.
```

## dts/bindings/misc/tenstorrent,d2d-link.yaml
```yaml
# Copyright (c) 2026 Tenstorrent AI ULC
# SPDX-License-Identifier: Apache-2.0

description: |
  A physical D2D link endpoint description used by chiplet remote-boot
  drivers. Local links have one local D2D tile and one remote I3C endpoint.
  Remote-only links have two remote I3C endpoints.

compatible: "tenstorrent,d2d-link"

include: base.yaml

properties:
  local-d2d:
    type: phandle
    required: false

  remote-i3c:
    type: phandle
    required: false

  remote-instance:
    type: int
    required: false

  remote-a-i3c:
    type: phandle
    required: false

  remote-a-instance:
    type: int
    required: false

  remote-b-i3c:
    type: phandle
    required: false

  remote-b-instance:
    type: int
    required: false
```

## dts/bindings/misc/tenstorrent,mimir-remote-boot.yaml
```yaml
# Copyright (c) 2026 Tenstorrent AI ULC
# SPDX-License-Identifier: Apache-2.0

description: |
  Tenstorrent Mimir remote boot driver.

  Reads the Mimir FW image from the BUN2 staging area at the TOC index
  given by fw-toc-index, then OCCP-loads it onto each remote processor
  listed in smc-remoteproc. All Mimirs share the same FW, D2D FW, and
  GDDR params images. Also records the TOC indices for the D2D FW and
  GDDR params images, for future use.

compatible: "tenstorrent,mimir-remote-boot"

include: base.yaml

properties:
  smc-remoteproc:
    type: phandles
    required: true
    description: |
      List of tenstorrent,smc-remoteproc devices, one per Mimir, used to
      OCCP-load and start Mimir.

  mis-mbox:
    type: phandles
    required: false
    description: |
      Optional list of mailboxes, one per Mimir, used to prompt each Mimir
      to jump to its MIS image after the image has been copied over.

  mis-spa-bases:
    type: array
    required: false
    description: |
      SPA base of each Mimir's core-local address window, as {hi, lo} 32-bit
      cell pairs in the same order as mis-mbox. The MIS image load address in
      the bundle is core-local, and is added to this base to reach each Mimir.

  fw-toc-index:
    type: int
    default: 1
    description: |
      Index into the BUN2 TOC for the Mimir FW image. Defaults to 1.

  d2d-fw-toc-index:
    type: int
    default: 2
    description: |
      Index into the BUN2 TOC for the Mimir D2D FW image. Defaults to 2.

  gddr-params-toc-index:
    type: int
    default: 3
    description: |
      Index into the BUN2 TOC for the Mimir GDDR params image. Defaults to 3.
```

## dts/bindings/misc/tenstorrent,smc-remoteproc.yaml
```yaml
# Copyright (c) 2025 Tenstorrent AI ULC
# SPDX-License-Identifier: Apache-2.0

description: |
  Tenstorrent SMC remote processor

compatible: "tenstorrent,smc-remoteproc"

include: [i3c-device.yaml]

properties:
  boot-gpios:
    type: phandle-array
    description: |
      Optional GPIO used to signal when the remote processor ROM is ready.
      If omitted, the driver skips the GPIO wait but still performs an
      additional DAA during initialization.
```

## tests/drivers/tt_pcie/testcase.yaml
```yaml
common:
  tags:
    - drivers
tests:
  drivers.tt_pcie.endpoint:
    tags: smoke
    platform_allow:
      - tt_mmk/tt_keraunos/smc
```
