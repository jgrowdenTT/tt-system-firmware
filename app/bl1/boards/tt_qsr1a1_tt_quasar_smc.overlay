/*
 * Copyright (c) 2026 Tenstorrent AI ULC
 *
 * SPDX-License-Identifier: Apache-2.0
 */

/* BL1 starts 128KB from the end of ram0; text+data fit in the first 64KB.
 * The window stops short of vuart_ram so the console buffer is left alone.
 */
&ram0 {
	reg = <0x0 0xc013b000 0x0 0x1d000>;
};

/* First stage to run on Mimir, so it puts the persistent vuart into a known state */
&vuart0 {
	init-metadata;
};

&{/soc} {
	/* Quasar SPA view of Keraunos' mbox0 */
	k_mbox: mbox@1202018000 {
		compatible = "tenstorrent,grendel-mbox";
		reg = <0x12 0x02018000 0x0 0x20000>;
		channel-pairs = <32>;
		#mbox-cells = <1>;
	};
};
