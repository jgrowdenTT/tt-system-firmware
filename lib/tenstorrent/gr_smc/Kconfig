## lib/tenstorrent/gr_smc/Kconfig
```kconfig
# Copyright (c) 2026 Tenstorrent AI ULC
# SPDX-License-Identifier: Apache-2.0

config GR_SMC_JUMP_TO
	bool "gr_smc_jump_to(): hand the core to the next image"
	depends on TT_GR_SMC
	default y
	help
	  Compile gr_smc_jump_to() and declare it FUNC_NORETURN. The jump never returns on
	  hardware. Turn this off where a test replaces the jump with a fake that returns, so the
	  caller is not compiled against a noreturn function.

config TT_GR_SMC
	bool "Grendel SMC support library"
	select SIVAL_SDK
	help
	  Enable Tenstorrent Grendel SMC support library components.

config TT_GR_SMC_ERR_STR
	bool "Grendel SMC error-string table (Sival SDK err.c)"
	select TT_GR_SMC
	default n
	help
	  Compile grendel_err_to_str from the grendel-sival-sdk tarball's
	  common/src/err.c

config TT_GR_SMC_LOG_BRIDGE
	bool "Grendel SMC log bridge"
	depends on LOG
	select TT_GR_SMC
	default n
	help
	  Provide strong log_message/log_with_location overrides for Grendel
	  firmware logging hooks and route them into Zephyr logging.

if TT_GR_SMC_LOG_BRIDGE

module = TT_GR_SMC_LOG_BRIDGE
module-str = Grendel SMC log bridge
source "subsys/logging/Kconfig.template.log_config"

endif # TT_GR_SMC_LOG_BRIDGE
```

## test-conf/tests/drivers/gpio/gpio_api_1pin/testcase.yaml
```yaml
common:
  tags:
    - drivers
    - gpio
  depends_on: gpio
tests:
  drivers.gpio.1pin:
    # Plain scenario on MMK: no external pull-down and no gpio_external_pull_down fixture.
    tags: smoke
    platform_allow:
      - tt_mmk/tt_keraunos/smc
      - tt_mmk/tt_mimir/smc
    extra_args:
      - "platform:tt_mmk/tt_keraunos/smc:DTC_OVERLAY_FILE=\
         ../../../../../tt-system-firmware/test-conf/tests/drivers/gpio/gpio_api_1pin/\
         boards/tt_mmk_smc.overlay"
      - "platform:tt_mmk/tt_keraunos/smc:CONF_FILE=\
         ../../../../../tt-system-firmware/test-conf/tests/drivers/gpio/gpio_api_1pin/\
         boards/tt_mimir_tt_mimir_smc.conf"
      - "platform:tt_mmk/tt_mimir/smc:DTC_OVERLAY_FILE=\
         ../../../../../tt-system-firmware/test-conf/tests/drivers/gpio/gpio_api_1pin/\
         boards/tt_mmk_smc.overlay"
      - "platform:tt_mmk/tt_mimir/smc:CONF_FILE=\
         ../../../../../tt-system-firmware/test-conf/tests/drivers/gpio/gpio_api_1pin/\
         boards/tt_mimir_tt_mimir_smc.conf"

  drivers.gpio.1pin.external_pull_down:
    # Needs the external pull-down node and the gpio_external_pull_down fixture.
    platform_allow:
      - tt_blackhole@p100a/tt_blackhole/smc
      - tt_blackhole@p150a/tt_blackhole/smc
      - tt_blackhole@p150b/tt_blackhole/smc
      - tt_blackhole@p300a/tt_blackhole/smc
      - tt_mimir/tt_mimir/smc
    extra_args:
      - "platform:tt_blackhole@p100a/tt_blackhole/smc:DTC_OVERLAY_FILE=\
         ../../../../../tt-system-firmware/test-conf/tests/drivers/gpio/gpio_api_1pin/\
         boards/tt_blackhole_tt_blackhole_smc.overlay"
      - "platform:tt_blackhole@p150a/tt_blackhole/smc:DTC_OVERLAY_FILE=\
         ../../../../../tt-system-firmware/test-conf/tests/drivers/gpio/gpio_api_1pin/\
         boards/tt_blackhole_tt_blackhole_smc.overlay"
      - "platform:tt_blackhole@p150b/tt_blackhole/smc:DTC_OVERLAY_FILE=\
         ../../../../../tt-system-firmware/test-conf/tests/drivers/gpio/gpio_api_1pin/\
         boards/tt_blackhole_tt_blackhole_smc.overlay"
      - "platform:tt_blackhole@p300a/tt_blackhole/smc:DTC_OVERLAY_FILE=\
         ../../../../../tt-system-firmware/test-conf/tests/drivers/gpio/gpio_api_1pin\
         boards/tt_blackhole_tt_blackhole_smc.overlay"
      - "platform:tt_mimir/tt_mimir/smc:DTC_OVERLAY_FILE=\
         ../../../../../tt-system-firmware/test-conf/tests/drivers/gpio/gpio_api_1pin/\
         boards/tt_mimir_tt_mimir_smc.overlay"
      - "platform:tt_mimir/tt_mimir/smc:CONF_FILE=\
         ../../../../../tt-system-firmware/test-conf/tests/drivers/gpio/gpio_api_1pin/\
         boards/tt_mimir_tt_mimir_smc.conf"
    harness_config:
      fixture: gpio_external_pull_down
```

## test-conf/tests/drivers/gpio/gpio_basic_api/testcase.yaml
```yaml
common:
  tags:
    - drivers
    - gpio
    - smoke
  depends_on: gpio
  harness: ztest
  harness_config:
    fixture: gpio_loopback
tests:
  drivers.gpio.2pin:
    platform_allow:
      - tt_mmk/tt_keraunos/smc
      - tt_mmk/tt_mimir/smc
      - tt_qsr1a1/tt_keraunos/smc
      - tt_qsr1a1/tt_mimir/smc
      - tt_qsr1a1/tt_quasar/smc
    extra_args:
      - "platform:tt_mmk/tt_keraunos/smc:DTC_OVERLAY_FILE=\
         ../../../../../tt-system-firmware/test-conf/tests/drivers/gpio/gpio_basic_api/\
         boards/tt_mmk_tt_keraunos_smc.overlay"
      - "platform:tt_mmk/tt_mimir/smc:DTC_OVERLAY_FILE=\
         ../../../../../tt-system-firmware/test-conf/tests/drivers/gpio/gpio_basic_api/\
         boards/tt_mmk_tt_keraunos_smc.overlay"
      - "platform:tt_qsr1a1/tt_keraunos/smc:DTC_OVERLAY_FILE=\
         ../../../../../tt-system-firmware/test-conf/tests/drivers/gpio/gpio_basic_api/\
         boards/tt_mmk_tt_keraunos_smc.overlay"
      - "platform:tt_qsr1a1/tt_mimir/smc:DTC_OVERLAY_FILE=\
         ../../../../../tt-system-firmware/test-conf/tests/drivers/gpio/gpio_basic_api/\
         boards/tt_mmk_tt_keraunos_smc.overlay"
      - "platform:tt_qsr1a1/tt_quasar/smc:DTC_OVERLAY_FILE=\
         ../../../../../tt-system-firmware/test-conf/tests/drivers/gpio/gpio_basic_api/\
         boards/tt_mmk_tt_keraunos_smc.overlay"
```

## tests/app/bl0p5_launch/testcase.yaml
```yaml
common:
  tags:
    - app
    - bl0p5
    - smoke
  harness: ztest
tests:
  app.bl0p5.launch:
    platform_allow:
      - native_sim/native/64
      - tt_mmk/tt_keraunos/smc
      - tt_qsr1a1/tt_keraunos/smc
```

## tests/app/bl1_mis_k_device/testcase.yaml
```yaml
common:
  tags:
    - app
    - bl1
  harness: ztest
tests:
  app.bl1.mis_launch.k.device:
    tags:
      - app
      - bl1
      - smoke
    platform_allow:
      - tt_mmk/tt_keraunos/smc
    extra_args:
      - "DTC_OVERLAY_FILE=boards/mis_k_device.overlay"
```

## tests/app/bl1_mis_mq_device/testcase.yaml
```yaml
common:
  tags:
    - app
    - bl1
  harness: ztest

tests:
  app.bl1.mis_launch.mq.device:
    tags:
      - app
      - bl1
    platform_allow:
      - tt_mmk/tt_mimir/smc
    extra_args:
      - "DTC_OVERLAY_FILE=boards/mis_mq_device.overlay"
```

## tests/drivers/dma/tt_grendel_dma/testcase.yaml
```yaml
tests:
  drivers.dma.tt_grendel_dma:
    tags:
      - drivers
      - dma
      - smoke
    harness: ztest
    platform_allow:
      - tt_mmk/tt_keraunos/smc
      - tt_mmk/tt_mimir/smc
      - tt_qsr1a1/tt_keraunos/smc
      - tt_qsr1a1/tt_mimir/smc
      - tt_qsr1a1/tt_quasar/smc
    extra_args:
      - "DTC_OVERLAY_FILE=boards/tt_grendel.overlay"
```

## tests/drivers/tt_smc_remoteproc_error/testcase.yaml
```yaml
common:
  tags:
    - drivers
tests:
  drivers.tt_smc_remoteproc_error.error_paths:
    tags: smoke
    platform_allow:
      - tt_mmk/tt_keraunos/smc
      - tt_qsr1a1/tt_keraunos/smc
    harness: ztest
```

## tests/drivers/uart_tt_virt/testcase.yaml
```yaml
tests:
  drivers.uart_tt_virt:
    tags: smoke
    platform_allow:
      - tt_mmk/tt_keraunos/smc
      - tt_mmk/tt_mimir/smc
      - tt_qsr1a1/tt_keraunos/smc
      - tt_qsr1a1/tt_mimir/smc
      - tt_qsr1a1/tt_quasar/smc
    extra_args:
      - "DTC_OVERLAY_FILE=tt_vuart_adopt.overlay"
```

## tests/lib/tenstorrent/gr_smc/testcase.yaml
```yaml
tests:
  lib.tenstorrent.gr_smc:
    platform_allow:
      - tt_mmk/tt_keraunos/smc
    integration_platforms:
      - tt_mmk/tt_keraunos/smc
    tags:
      - gr_smc
      - lib
    harness: ztest
```
